## boards/arm/stm32/blackboard-stm32f407/configs/nsh/defconfig
```kconfig
CONFIG_HOST_LINUX=y
CONFIG_APPS_DIR="../apps"
CONFIG_INTELHEX_BINARY=y
CONFIG_ARCH_ARM=y
CONFIG_ARCH="arm"
CONFIG_ARCH_CHIP_STM32=y
CONFIG_ARCH_CORTEXM4=y
CONFIG_ARCH_FAMILY="armv7-m"
CONFIG_ARCH_CHIP="stm32"
CONFIG_ARCH_HAVE_FPU=y
CONFIG_ARCH_CHIP_STM32F407ZG=y
CONFIG_ARCH_BLACKBOARD_STM32F407=y
CONFIG_ARCH_BOARD="blackboard-stm32f407"
CONFIG_BOARD_LOOPSPERMSEC=16717

CONFIG_RAM_START=0x20000000
CONFIG_RAM_SIZE=196608
CONFIG_START_YEAR=2018
CONFIG_START_MONTH=1
CONFIG_START_DAY=1

CONFIG_MAX_WDOGPARMS=2
CONFIG_PREALLOC_WDOGS=8
CONFIG_WDOG_INTRESERVE=0
CONFIG_PREALLOC_TIMERS=4

CONFIG_USER_ENTRYPOINT="nsh_main"
CONFIG_RAW_BINARY=y
CONFIG_RR_INTERVAL=200
CONFIG_TASK_NAME_SIZE=0
CONFIG_MAX_TASKS=16
CONFIG_SCHED_WAITPID=y
CONFIG_SCHED_HPWORK=y
CONFIG_SCHED_HPWORKPRIORITY=192
CONFIG_SDCLONE_DISABLE=y
CONFIG_NFILE_DESCRIPTORS=8
CONFIG_NFILE_STREAMS=8
CONFIG_SERIAL_TERMIOS=y
CONFIG_STM32_USART1=y
CONFIG_USART1_SERIAL_CONSOLE=y
CONFIG_BUILTIN=y
CONFIG_SYMTAB_ORDEREDBYNAME=y
CONFIG_NSH_ARCHINIT=y
CONFIG_NSH_BUILTIN_APPS=y
CONFIG_NSH_FILEIOSIZE=1024
CONFIG_NSH_LINELEN=80
CONFIG_MM_REGIONS=2
CONFIG_SYSTEM_NSH=y

CONFIG_STM32_DISABLE_IDLE_SLEEP_DURING_DEBUG=y
CONFIG_STM32_JTAG_FULL_ENABLE=y
```
